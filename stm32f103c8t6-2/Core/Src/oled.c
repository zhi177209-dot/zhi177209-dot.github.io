#include "oled.h"

extern I2C_HandleTypeDef hi2c1;

volatile HAL_StatusTypeDef oled_last_i2c_status = HAL_OK;

static uint16_t oled_i2c_addr = OLED_DEV_ADDR_GND;
static uint8_t oled_ready = 0U;

static const uint8_t oled_zh16x16[OLED_ZH16X16_COUNT][36] = {
/* 0 */ {0xe6,0xb9,0xbf,0x00,0x10,0x60,0x02,0x8c,0x00,0xfe,0x92,0x92,0x92,0x92,0x92,0x92,0xfe,0x00,0x00,0x00,0x04,0x04,0x7e,0x01,0x44,0x48,0x50,0x7f,0x40,0x40,0x7f,0x50,0x48,0x44,0x40,0x00},
/* 1 */ {0xe5,0xba,0xa6,0x00,0x00,0x00,0xfc,0x24,0x24,0x24,0xfc,0x25,0x26,0x24,0xfc,0x24,0x24,0x24,0x04,0x00,0x40,0x30,0x8f,0x80,0x84,0x4c,0x55,0x25,0x25,0x25,0x55,0x4c,0x80,0x80,0x80,0x00},
/* 2 */ {0xef,0xbc,0x9a,0x00,0x00,0x00,0x00,0x00,0x00,0x00,0x00,0x30,0x30,0x00,0x00,0x00,0x00,0x00,0x00,0x00,0x00,0x00,0x00,0x00,0x00,0x00,0x00,0x0c,0x0c,0x00,0x00,0x00,0x00,0x00,0x00,0x00},
/* 3 */ {0xe6,0xb8,0xa9,0x00,0x10,0x60,0x02,0x8c,0x00,0x00,0xfe,0x92,0x92,0x92,0x92,0x92,0xfe,0x00,0x00,0x00,0x04,0x04,0x7e,0x01,0x40,0x7e,0x42,0x42,0x7e,0x42,0x7e,0x42,0x42,0x7e,0x40,0x00},
/* 4 */ {0xe5,0xba,0xa6,0x00,0x00,0x00,0xfc,0x24,0x24,0x24,0xfc,0x25,0x26,0x24,0xfc,0x24,0x24,0x24,0x04,0x00,0x40,0x30,0x8f,0x80,0x84,0x4c,0x55,0x25,0x25,0x25,0x55,0x4c,0x80,0x80,0x80,0x00},
/* 5 */ {0xef,0xbc,0x9a,0x00,0x00,0x00,0x00,0x00,0x00,0x00,0x00,0x30,0x30,0x00,0x00,0x00,0x00,0x00,0x00,0x00,0x00,0x00,0x00,0x00,0x00,0x00,0x00,0x0c,0x0c,0x00,0x00,0x00,0x00,0x00,0x00,0x00}
};

static const uint8_t oled_num8x16[12][16] = {
/*0*/ {0x00,0xF0,0xF8,0x0C,0x04,0x0C,0xF8,0xF0,0x00,0x0F,0x1F,0x30,0x20,0x30,0x1F,0x0F},
/*1*/ {0x00,0x10,0x18,0xFC,0xFC,0x00,0x00,0x00,0x00,0x20,0x20,0x3F,0x3F,0x20,0x20,0x00},
/*2*/ {0x00,0x18,0x1C,0x04,0x84,0xCC,0x78,0x30,0x00,0x30,0x38,0x2C,0x26,0x23,0x21,0x20},
/*3*/ {0x00,0x18,0x1C,0x84,0x84,0xCC,0x78,0x30,0x00,0x18,0x38,0x20,0x20,0x31,0x1F,0x0E},
/*4*/ {0x00,0xC0,0xF0,0x38,0x0C,0xFC,0xFC,0x00,0x00,0x07,0x07,0x06,0x06,0x3F,0x3F,0x06},
/*5*/ {0x00,0xFC,0xFC,0xCC,0xCC,0xCC,0x8C,0x00,0x00,0x18,0x38,0x20,0x20,0x31,0x1F,0x0E},
/*6*/ {0x00,0xF0,0xF8,0xCC,0xC4,0xC4,0x84,0x00,0x00,0x0F,0x1F,0x31,0x20,0x20,0x1F,0x0F},
/*7*/ {0x00,0x1C,0x1C,0x04,0xC4,0xF4,0x3C,0x0C,0x00,0x00,0x3C,0x3F,0x03,0x00,0x00,0x00},
/*8*/ {0x00,0x38,0x7C,0xC6,0x86,0xC6,0x7C,0x38,0x00,0x1C,0x3E,0x23,0x21,0x23,0x3E,0x1C},
/*9*/ {0x00,0x78,0xFC,0x86,0x06,0x06,0xFC,0xF8,0x00,0x20,0x21,0x31,0x19,0x0F,0x07,0x00},
/*.*/ {0x00,0x00,0x00,0x00,0x00,0x00,0x00,0x00,0x00,0x00,0x00,0x00,0x00,0x18,0x18,0x00},
/*-*/ {0x00,0x00,0x00,0x00,0x00,0x00,0x00,0x00,0x00,0x04,0x04,0x04,0x04,0x04,0x04,0x00}
};

static const uint8_t oled_demo_bmp[] = {
    0x03, 0x07, 0x03, 0x03, 0x03, 0x03, 0x03, 0x03, 0x03, 0x03, 0x03, 0x03, 0x03, 0x03, 0x03, 0x03,
    0x03, 0x03, 0x03, 0x03, 0x03, 0x03, 0x03, 0x03, 0x03, 0x03, 0x03, 0x03, 0x03, 0x03, 0x03, 0x03,
    0x03, 0x03, 0x03, 0x03, 0x03, 0x03, 0x03, 0x03, 0x03, 0x03, 0x1b, 0x07, 0x03, 0x03, 0x03, 0x03,
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    0xc0, 0xc0, 0xc0, 0xc0, 0xc0, 0xc0, 0xc0, 0xc0, 0xc0, 0xc0, 0xc0, 0xc0, 0xc0, 0xc0
};

static HAL_StatusTypeDef OLED_WriteByte(uint8_t ctrl, uint8_t value)
{
    uint8_t tx_buf[2] = {ctrl, value};

    if (oled_ready == 0U)
    {
        oled_last_i2c_status = HAL_ERROR;
        return oled_last_i2c_status;
    }

    oled_last_i2c_status = HAL_I2C_Master_Transmit(&hi2c1, oled_i2c_addr, tx_buf, 2, 100);
    if (oled_last_i2c_status != HAL_OK)
    {
        oled_ready = 0U;
    }

    return oled_last_i2c_status;
}

static void OLED_SetPos(uint8_t x, uint8_t page)
{
    OLED_WriteCmd((uint8_t)(0xB0U + page));
    OLED_WriteCmd((uint8_t)(x & 0x0FU));
    OLED_WriteCmd((uint8_t)(0x10U | (x >> 4)));
}

void OLED_WriteCmd(uint8_t cmd)
{
    (void)OLED_WriteByte(OLED_CMD_CTRL, cmd);
}

void OLED_WriteData(uint8_t dat)
{
    (void)OLED_WriteByte(OLED_DATA_CTRL, dat);
}

static void OLED_ShowGlyph8x16(uint8_t x, uint8_t page, const uint8_t glyph[16])
{
    uint8_t c;

    if (oled_ready == 0U || page >= 7U || x > 120U)
    {
        return;
    }

    OLED_SetPos(x, page);
    for (c = 0U; c < 8U; c++)
    {
        OLED_WriteData(glyph[c]);
    }

    OLED_SetPos(x, (uint8_t)(page + 1U));
    for (c = 0U; c < 8U; c++)
    {
        OLED_WriteData(glyph[c + 8U]);
    }
}

void OLED_Clear(void)
{
    uint8_t page;
    uint8_t col;

    if (oled_ready == 0U)
    {
        return;
    }

    for (page = 0U; page < 8U; page++)
    {
        OLED_SetPos(0U, page);
        for (col = 0U; col < 128U; col++)
        {
            OLED_WriteData(0x00U);
        }
    }
}

uint8_t OLED_Init(void)
{
    static const uint16_t probe_addrs[] = {OLED_DEV_ADDR_GND, OLED_DEV_ADDR_VCC};
    uint8_t i;

    oled_ready = 0U;
    oled_last_i2c_status = HAL_OK;

    HAL_Delay(100);

    for (i = 0U; i < (uint8_t)(sizeof(probe_addrs) / sizeof(probe_addrs[0])); i++)
    {
        if (HAL_I2C_IsDeviceReady(&hi2c1, probe_addrs[i], 2, 50) == HAL_OK)
        {
            oled_i2c_addr = probe_addrs[i];
            oled_ready = 1U;
            break;
        }
    }

    if (oled_ready == 0U)
    {
        oled_last_i2c_status = HAL_ERROR;
        return 0U;
    }

    OLED_WriteCmd(0xAE);
    OLED_WriteCmd(0xD5);
    OLED_WriteCmd(0x80);
    OLED_WriteCmd(0xA8);
    OLED_WriteCmd(0x3F);
    OLED_WriteCmd(0xD3);
    OLED_WriteCmd(0x00);
    OLED_WriteCmd(0x40);
    OLED_WriteCmd(0x8D);
    OLED_WriteCmd(0x14);
    OLED_WriteCmd(0x20);
    OLED_WriteCmd(0x02);
    OLED_WriteCmd(0xA1);
    OLED_WriteCmd(0xC8);
    OLED_WriteCmd(0xDA);
    OLED_WriteCmd(0x12);
    OLED_WriteCmd(0x81);
    OLED_WriteCmd(0xCF);
    OLED_WriteCmd(0xD9);
    OLED_WriteCmd(0xF1);
    OLED_WriteCmd(0xDB);
    OLED_WriteCmd(0x30);
    OLED_WriteCmd(0xA4);
    OLED_WriteCmd(0xA6);
    OLED_WriteCmd(0xAF);

    if (oled_ready == 0U)
    {
        return 0U;
    }

    OLED_Clear();
    return 1U;
}

void OLED_TestLine(void)
{
    uint8_t col;

    if (oled_ready == 0U)
    {
        return;
    }

    OLED_SetPos(0U, 0U);
    for (col = 0U; col < 128U; col++)
    {
        OLED_WriteData(0xFFU);
    }
}

void OLED_ShowZh16x16ByIndex(uint8_t x, uint8_t page, uint8_t index)
{
    uint8_t col;

    if (oled_ready == 0U)
    {
        return;
    }
    if (index >= OLED_ZH16X16_COUNT)
    {
        return;
    }
    if (x > 112U || page > 6U)
    {
        return;
    }

    OLED_SetPos(x, page);
    for (col = 0U; col < 16U; col++)
    {
        OLED_WriteData(oled_zh16x16[index][4U + col]);
    }

    OLED_SetPos(x, (uint8_t)(page + 1U));
    for (col = 0U; col < 16U; col++)
    {
        OLED_WriteData(oled_zh16x16[index][20U + col]);
    }
}

void OLED_ShowBMP(uint8_t x, uint8_t page, uint8_t width, uint8_t height, const uint8_t *bmp)
{
    uint8_t p;
    uint8_t col;
    uint8_t page_num;
    uint8_t draw_width;
    uint16_t index = 0U;

    if (oled_ready == 0U || bmp == 0)
    {
        return;
    }
    if (x >= 128U || page >= 8U || width == 0U || height == 0U)
    {
        return;
    }

    page_num = (uint8_t)((height + 7U) / 8U);
    draw_width = width;
    if ((uint16_t)x + draw_width > 128U)
    {
        draw_width = (uint8_t)(128U - x);
    }

    for (p = 0U; p < page_num; p++)
    {
        if ((uint8_t)(page + p) >= 8U)
        {
            break;
        }

        OLED_SetPos(x, (uint8_t)(page + p));
        for (col = 0U; col < draw_width; col++)
        {
            OLED_WriteData(bmp[index++]);
        }

        index = (uint16_t)(index + (uint16_t)(width - draw_width));
    }
}

void OLED_ShowDemoBMP(uint8_t x, uint8_t page)
{
    OLED_ShowBMP(x, page, OLED_DEMO_BMP_WIDTH, OLED_DEMO_BMP_HEIGHT, oled_demo_bmp);
}

void OLED_ShowNum8x16(uint8_t x, uint8_t page, int16_t num, uint8_t decimal_bits)
{
    static const uint16_t dec_scale[] = {1U, 10U, 100U, 1000U};
    char text[12];
    char int_buf[6];
    uint8_t i;
    uint8_t text_len = 0U;
    uint8_t int_len = 0U;
    int32_t value = num;
    uint16_t scale;
    uint16_t frac_div;
    uint16_t frac_part;
    uint32_t int_part;

    if (oled_ready == 0U || page >= 7U || x > 120U || decimal_bits > 3U)
    {
        return;
    }

    if (value < 0)
    {
        text[text_len++] = '-';
        value = -value;
    }

    scale = dec_scale[decimal_bits];
    int_part = (uint32_t)value / scale;
    frac_part = (uint16_t)((uint32_t)value % scale);

    if (int_part == 0U)
    {
        int_buf[int_len++] = '0';
    }
    else
    {
        while (int_part > 0U && int_len < sizeof(int_buf))
        {
            int_buf[int_len++] = (char)('0' + (int_part % 10U));
            int_part /= 10U;
        }
    }

    while (int_len > 0U)
    {
        text[text_len++] = int_buf[--int_len];
    }

    if (decimal_bits > 0U)
    {
        text[text_len++] = '.';
        frac_div = (uint16_t)(scale / 10U);

        while (frac_div > 0U && text_len < sizeof(text))
        {
            text[text_len++] = (char)('0' + (frac_part / frac_div));
            frac_part %= frac_div;
            frac_div /= 10U;
        }
    }

    for (i = 0U; i < text_len; i++)
    {
        uint8_t glyph_index;

        if ((uint16_t)x + (uint16_t)(i * 8U) > 120U)
        {
            break;
        }

        if (text[i] >= '0' && text[i] <= '9')
        {
            glyph_index = (uint8_t)(text[i] - '0');
        }
        else if (text[i] == '.')
        {
            glyph_index = 10U;
        }
        else if (text[i] == '-')
        {
            glyph_index = 11U;
        }
        else
        {
            continue;
        }

        OLED_ShowGlyph8x16((uint8_t)(x + i * 8U), page, oled_num8x16[glyph_index]);
    }
}

void OLED_ShowSingleNum8x16(uint8_t x, uint8_t page, uint8_t ch)
{
    if (oled_ready == 0U || ch > 11U || page >= 7U || x > 120U)
    {
        return;
    }

    OLED_ShowGlyph8x16(x, page, oled_num8x16[ch]);
}
